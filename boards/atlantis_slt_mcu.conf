## boards/atlantis_slt_mcu.conf
```kconfig
# Gentoo mode
CONFIG_SPEED_OPTIMIZATIONS=y

CONFIG_NOCACHE_MEMORY=y

CONFIG_APP_SENSORS=y

# Redfish system overview (board-specific)
CONFIG_REDFISH_SYSTEM_PRODUCT_NAME="Atlantis SLT"
CONFIG_REDFISH_SYSTEM_MANUFACTURER="Tenstorrent"
CONFIG_REDFISH_SYSTEM_MODEL="Atlantis SLT"
CONFIG_REDFISH_SYSTEM_PROCESSOR_MODEL="Tenstorrent Atlantis"
```

## boards/tenstorrent/atlantis_evb_mcu/Kconfig.atlantis_evb_mcu
```kconfig
# SPDX-FileCopyrightText: © 2026 Tenstorrent USA, Inc.
# SPDX-License-Identifier: Apache-2.0

config BOARD_ATLANTIS_EVB_MCU
	select SOC_STM32F746XX
```

## boards/tenstorrent/atlantis_evb_mcu/Kconfig.defconfig
```kconfig
# atlantis_evb_mcu board configuration

# SPDX-FileCopyrightText: © 2026 Tenstorrent USA, Inc.
# SPDX-License-Identifier: Apache-2.0

if BOARD_ATLANTIS_EVB_MCU

if NETWORKING

config NET_L2_ETHERNET
	default y

endif # NETWORKING

endif # BOARD_ATLANTIS_EVB_MCU
```

## boards/tenstorrent/atlantis_evb_mcu/board.yml
```yaml
board:
  name: atlantis_evb_mcu
  full_name: Tenstorrent Atlantis EVB MCU
  vendor: tenstorrent
  socs:
    - name: stm32f746xx
```

## boards/tenstorrent/atlantis_slt_mcu/Kconfig.defconfig
```kconfig
# atlantis_slt_mcu board configuration

# SPDX-FileCopyrightText: © 2026 Tenstorrent USA, Inc.
# SPDX-License-Identifier: Apache-2.0

if BOARD_ATLANTIS_SLT_MCU

if NETWORKING

config NET_L2_ETHERNET
	default y

endif # NETWORKING

endif # BOARD_ATLANTIS_SLT_MCU
```

## boards/tenstorrent/atlantis_slt_mcu/board.yml
```yaml
board:
  name: atlantis_slt_mcu
  full_name: Tenstorrent Atlantis SLT MCU
  vendor: tenstorrent
  socs:
    - name: stm32f746xx
```

## dts/bindings/wallabmc,power-rail.yaml
```yaml
# SPDX-FileCopyrightText: © 2026 Tenstorrent USA, Inc.
# SPDX-License-Identifier: Apache-2.0

description: |
  Host power rail driven by the BMC: an enable GPIO and the power-good
  inputs that confirm it. A wallabmc,power-sequencer node lists the
  rails in the order they are brought up and down.

  Example:

    p5v: p5v {
        compatible = "wallabmc,power-rail";
        enable = <&power_5v_en>;
        power-good = <&pwr_good_5v>;
        off-delay-ms = <100>;
    };
    vcore: vcore {
        compatible = "wallabmc,power-rail";
        enable = <&vcore_0v8_en>;
        power-good = <&pg_ph1>;
        power-good-optional = <&pg_ph2>;
    };

compatible: "wallabmc,power-rail"

include: base.yaml

properties:
  enable:
    type: phandle
    required: true
    description: |
      Node with a gpios property (for example a gpio-leds child) whose
      GPIO is driven active to bring the rail up and inactive to take it
      down.

  power-good:
    type: phandles
    description: |
      Nodes with a gpios property that must all read inactive before
      the enable is asserted and active afterwards. They are polled
      every millisecond for up to power-good-timeout-ms; on timeout the
      power on fails and the rails that came up are taken down again.

  power-good-optional:
    type: phandles
    description: |
      Like power-good, but only checked after the enable and a timeout
      logs a warning instead of failing. For power-good outputs the MCU
      cannot read reliably.

  power-good-timeout-ms:
    type: int
    default: 1000
    description: Time allowed for the power-good inputs to change level.

  settle-ms:
    type: int
    default: 0
    description: |
      Delay after the rail is up (power-good inputs active, or the
      enable asserted when there are none) before the next rail or,
      after the last rail, before the host reset is released.

  off-delay-ms:
    type: int
    default: 0
    description: |
      Delay on power off (and on the back-out after a failed power on)
      between taking down the rail before this one in the
      power-off-sequence and driving this rail's enable inactive. For a
      rail the regulators taken down earlier need while they shut down.
```

## dts/bindings/wallabmc,power-sequencer.yaml
```yaml
# SPDX-FileCopyrightText: © 2026 Tenstorrent USA, Inc.
# SPDX-License-Identifier: Apache-2.0

description: |
  Host power sequencer.

  power-on-sequence lists wallabmc,power-rail nodes in the order they are
  brought up: each rail waits for its power-good inputs to read inactive,
  drives its enable active, waits for them to read active and then waits
  its settle-ms. power-off-sequence lists them in the order they are taken
  down, usually the reverse; a rail with off-delay-ms is taken down that
  long after the rail before it. A failed power on takes down the rails
  that came up, in power-off-sequence order. The host reset GPIO (alias
  reset-gpio-1), if there is one, is asserted before the first rail comes
  up and released after the last. The fault inputs are watched while the
  host runs; one going active powers the host off.

  Example:

    power_sequencer: power-sequencer {
        compatible = "wallabmc,power-sequencer";
        power-on-sequence = <&p5v &vcore>;
        power-off-sequence = <&vcore &p5v>;
        fault = <&tj_max>;
    };

compatible: "wallabmc,power-sequencer"

include: base.yaml

properties:
  power-on-sequence:
    type: phandles
    required: true
    description: The wallabmc,power-rail nodes in power-on order.

  power-off-sequence:
    type: phandles
    required: true
    description: |
      The same rails in power-off order. Every rail in power-on-sequence
      must appear here.

  fault:
    type: phandles
    description: |
      Nodes with a gpios property that the host drives active to demand
      an immediate power off, such as a junction over-temperature line.
      Each is armed as an edge interrupt once the last rail is up and the
      host reset is released, and disarmed before the host is reset or
      powered off, so the level while the host is off or in reset does
      not matter. Every edge logs an error and walks power-off-sequence.
      The pin must be able to interrupt (on STM32 no other interrupt may
      use the same pin number); if arming fails the power on backs out.
```
